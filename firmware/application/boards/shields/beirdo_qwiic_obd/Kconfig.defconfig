## firmware/application/boards/shields/beirdo_qwiic_obd/Kconfig.defconfig
```kconfig
# Beirdo's QWIIC ODBII configuration

# Copyright (c) 2023 Gavin Hurlbut
# SPDX-License-Identifier: Apache-2.0

config SHIELD
	default "beirdo_qwiic_obd_v1"
	depends on BOARD_BEIRDO_QWIIC_OBD_V1
```

## firmware/application/drivers/adc/Kconfig.mcp342x
```kconfig
# MCP320x ADC configuration options

# Copyright (c) 2020 Vestas Wind Systems A/S
# SPDX-License-Identifier: Apache-2.0

config ADC_MCP322X
	bool "MCP3222/23/24 driver"
	default y
	depends on DT_HAS_MICROCHIP_MCP3222_ENABLED || DT_HAS_MICROCHIP_MCP3223_ENABLED || DT_HAS_MICROCHOP_MCP3234_ENABLED
	select I2C
	help
	  Enable MCP322/23/24 ADC driver.

	  The MCP3222/23/24 are 2/4 channel 12 to 18-bit A/D converters
	  with I2C interface.

if ADC_MCP322X

config ADC_MCP322X_ACQUISITION_THREAD_STACK_SIZE
	int "Stack size for the ADC data acquisition thread"
	default 512
	help
	  Size of the stack used for the internal data acquisition
	  thread.

config ADC_MCP322X_ACQUISITION_THREAD_PRIO
	int "Priority for the ADC data acquisition thread"
	default 0
	help
	  Priority level for the internal ADC data acquisition thread.

endif # ADC_MCP322X
```

## firmware/application/drivers/serial/Kconfig.sc16is741a
```kconfig
# SPDX-License-Identifier: Apache-2.0

menuconfig UART_SC16IS741A
	bool "SC16IS741A serial driver"
	default y
	depends on DT_HAS_SC16IS741A_ENABLED
	depends on I2C
	select SERIAL_HAS_DRIVER
	select SERIAL_SUPPORT_INTERRUPT
	help
	  This option enables the SC16IS741A serial driver.
	  This driver can be used for the serial hardware
	  available on x86 boards.

if UART_SC16IS741A

config UART_SC16IS741A_LINE_CTRL
	bool "Serial Line Control for Apps"
	depends on UART_LINE_CTRL
	help
	  This enables the API for apps to control the serial line,
	  such as CTS and RTS.

	  Says n if not sure.

config UART_SC16IS741A_DRV_CMD
	bool "Driver Commands"
	depends on UART_DRV_CMD
	help
	  This enables the API for apps to send commands to driver.

	  Says n if not sure.

config UART_SC16IS741A_FIFO
	bool "Enable 64-bytes FIFO and auto flow control"
	help
	  This enables support for 64-bytes FIFO and automatic hardware
	  flow control

menu "SC16IS741A Workarounds"

config UART_SC16IS741A_WA_ISR_REENABLE_INTERRUPT
	bool "Re-enable interrupts by toggling IER at end of ISR"
	depends on UART_INTERRUPT_DRIVEN
	help
	  In some configurations (e.g. edge interrupt triggers),
	  an interruptible event occurs during ISR and the host interrupt
	  controller does not see the new event due to IIR is constantly
	  asserting interrupts. For example, the callback handles RX and
	  then TX. If another character comes in before end of TX processing
	  (TX interrupt still asserts while raising RX interrupt), the host
	  interrupt controller may not see this new event. So if needed,
	  the IER is being toggled to re-assert interrupts at the end of ISR
	  to nudge the host interrupt controller to fire the ISR again.

endmenu

endif # UART_SC16IS741A
```

## firmware/application/drivers/spi/Kconfig.sc18is602b
```kconfig
# Copyright (c) 2021, Marc Reilly, Creative Product Design
# SPDX-License-Identifier: Apache-2.0

config SPI_SC18IS602B
	bool "NXP SC18IS602B I2C-SPI Bridge"
	default y
	depends on DT_HAS_SPI_SC18IS602B_ENABLED
	depends on I2C
	help
	  Enable the NXP SC18IS602B I2C-SPI bridge
```

## firmware/application/zephyr/boards/shields/beirdo_qwiic_obd/Kconfig.defconfig
```kconfig
# Beirdo's QWIIC ODBII configuration

# Copyright (c) 2023 Gavin Hurlbut
# SPDX-License-Identifier: Apache-2.0

config SHIELD_BEIRDO_QWIIC_OBD
	def_bool $(shields_list_contains,beirdo_qwiic_obd)
	default "beirdo_qwiic_obd_v1"
	depends on SHIELD_BEIRDO_QWIIC_OBD_V1
```

## firmware/application/zephyr/boards/shields/beirdo_qwiic_obd/Kconfig.shield
```kconfig
# Beirdo's Vehicle CAN Collector configuration

# Copyright (c) 2022 Gavin Hurlbut
# SPDX-License-Identifier: Apache-2.0

config SHIELD_BEIRDO_QWIIC_OBD_V1
	bool "Beirdo's QWIIC OBD v1"
	def_bool $(shields_list_contains,beirdo_qwiic_obd_v1)
	depends on ADC_MCP342X
	depends on SPI_SC18IS602B
	depends on CAN_J1850_PROCESS
	depends on I2C
	depends on GPIO_TCA953X
	depends on SERIAL_C16IS741A
	depends on CAN_MCP2515
	depends on SPI
```

## firmware/application/zephyr/dts/bindings/adc/microchip,mcp3423.yaml
```yaml
description: Microchip MCP3423

compatible: "microchip,mcp3423"

include: microchip,mcp342x-base.yaml
```

## firmware/application/zephyr/dts/bindings/adc/microchip,mcp342x-base.yaml
```yaml
# Common fields for Microchip MCP324x series

include: [adc-controller.yaml, i2c-device.yaml]

properties:
    "#io-channel-cells":
      const: 1

io-channel-cells:
    - channel
```

## firmware/application/zephyr/dts/bindings/can/beirdo,j1850process.yaml
```yaml
# Copyright (c) 2023 Gavin Hurlbut
# SPDX-License-Identifier: Apache-2.0

description: Custom J1850 Interface

compatible: "beirdo,j1850process"

include: [i2c-device.yaml, can-controller.yaml]

properties:
    reg:
      type: array
      required: true
```

## firmware/application/zephyr/dts/bindings/serial/nxp,sc16is741a.yaml
```yaml
description: NXP SC16IS741A I2C UART

compatible: "nxp,sc16is741a"

include: [i2c-device.yaml, uart-controller.yaml]

properties:
    reg:
      required: true
```

## firmware/application/zephyr/dts/bindings/spi/nxp,sc18is602b.yaml
```yaml
# Copyright (c) 2023 Gavin Hurlbut
# SPDX-License-Identifier: Apache-2.0

description: NXP SC18IS602B I2C-SPI bridge

compatible: "nxp,sc18is602b"

include: [i2c-device.yaml, spi-controller.yaml]

properties:
    reg:
      required: true

    interrupts:
      required: true
```

## firmware/obd-feather/zephyr/Kconfig
```kconfig
# Private config options for can sample app

# Copyright (c) 2018 Alexander Wachter
# SPDX-License-Identifier: Apache-2.0

mainmenu "OBDII Feather Board"

source "Kconfig.zephyr"
```

## firmware/obd-feather/zephyr/boards/shields/beirdo_obd_feather/Kconfig.defconfig
```kconfig
# Beirdo's QWIIC ODBII configuration

# Copyright (c) 2023 Gavin Hurlbut
# SPDX-License-Identifier: Apache-2.0

config SHIELD_BEIRDO_OBD_FEATHER
	def_bool $(shields_list_contains,beirdo_obd_feather)
	default "beirdo_obd_feather_v1"
	depends on SHIELD_BEIRDO_OBD_FEATHER_V1
```

## firmware/obd-feather/zephyr/boards/shields/beirdo_obd_feather/Kconfig.shield
```kconfig
# Beirdo's Vehicle CAN Collector configuration

# Copyright (c) 2023 Gavin Hurlbut
# SPDX-License-Identifier: Apache-2.0

config SHIELD_BEIRDO_OBD_FEATHER_V1
	bool "Beirdo's OBDII Feather v1"
	def_bool $(shields_list_contains,beirdo_obd_feather_v1)
    depends on CAN
    depends on ADC
	depends on I2C
	depends on GPIO_PCA953X
	
```
